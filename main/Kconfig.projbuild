## main/Kconfig.projbuild
```kconfig
menu "Sensor Project Configuration"

    config WIFI_SSID
        string "WiFi SSID"
        default "myssid"
        help
            SSID of the access point to connect to.

    config WIFI_PASSWORD
        string "WiFi Password"
        default "mypassword"
        help
            WPA/WPA2 password for the access point.

    config MQTT_BROKER_URI
        string "MQTT Broker URI"
        default "mqtt://192.168.1.100:1883"
        help
            URI of the local Mosquitto broker, e.g. mqtt://192.168.1.50:1883

endmenu
```
